#include "dactyl_manuform_5x7.dtsi"

&kscan0 {
    row-gpios
        = <&gpio0 31 (GPIO_ACTIVE_HIGH | GPIO_PULL_DOWN)>
        , <&gpio0 29 (GPIO_ACTIVE_HIGH | GPIO_PULL_DOWN)>
        , <&gpio0  2 (GPIO_ACTIVE_HIGH | GPIO_PULL_DOWN)>
        , <&gpio1 15 (GPIO_ACTIVE_HIGH | GPIO_PULL_DOWN)>
        , <&gpio1  7 (GPIO_ACTIVE_HIGH | GPIO_PULL_DOWN)>
        ;

    col-gpios
        = <&gpio1  6 GPIO_ACTIVE_HIGH>
        , <&gpio1  4 GPIO_ACTIVE_HIGH>
        , <&gpio0 11 GPIO_ACTIVE_HIGH>
        , <&gpio1  0 GPIO_ACTIVE_HIGH>
        , <&gpio0 24 GPIO_ACTIVE_HIGH>
        , <&gpio0 22 GPIO_ACTIVE_HIGH>
        , <&gpio0 20 GPIO_ACTIVE_HIGH>
        ;
};
