## boards/shields/dactyl_manuform_5x7/Kconfig.defconfig
```kconfig
if SHIELD_DACTYL_MANUFORM_5x7_LEFT
    config ZMK_KEYBOARD_NAME
        default "Dactyl Manuform"
endif

if SHIELD_DACTYL_MANUFORM_5x7_RIGHT
    config ZMK_KEYBOARD_NAME
        default "Dactyl Manuform Aux"

    config ZMK_SPLIT_ROLE_CENTRAL
        default y
endif

if SHIELD_DACTYL_MANUFORM_5x7_LEFT || SHIELD_DACTYL_MANUFORM_5x7_RIGHT
    config ZMK_SPLIT
        default y
endif
```

## boards/shields/dactyl_manuform_5x7/Kconfig.shield
```kconfig
config SHIELD_DACTYL_MANUFORM_5x7_LEFT
    def_bool $(shields_list_contains,dactyl_manuform_5x7_left)

config SHIELD_DACTYL_MANUFORM_5x7_RIGHT
    def_bool $(shields_list_contains,dactyl_manuform_5x7_right)
```

## config/west.yml
```yaml
manifest:
  remotes:
    - name: zmkfirmware
      url-base: https://github.com/petejohanson
    - name: pmw3610-driver
      url-base: https://github.com/inorichi
  projects:
    - name: zmk
      remote: zmkfirmware
      revision: feat/pointers-move-scroll
      import: app/west.yml
    - name: zmk-pmw3610-driver
      remote: pmw3610-driver
      revision: main
  self:
    path: config
```
